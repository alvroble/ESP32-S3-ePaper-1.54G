## Example/ESP-IDF_5.5.1/09_E_Paper_Test/main/Kconfig.projbuild
```kconfig
menu "WiFi Configuration"

    config WIFI_SSID
        string "WiFi SSID"
        default ""
        help
            SSID of the WiFi network the ticker will connect to.
            Set this via 'idf.py menuconfig' before flashing.
            Leave empty to disable auto-connect (useful for development).

    config WIFI_PASSWORD
        string "WiFi Password"
        default ""
        help
            WPA2 password for the configured WiFi SSID.
            Leave empty for open networks. Set via 'idf.py menuconfig'.

endmenu

menu "Display Configuration"

    config TIMEZONE
        string "POSIX TZ string (local time zone)"
        default "CET-1CEST,M3.5.0,M10.5.0/3"
        help
            POSIX TZ database string that drives the clock shown on the
            e-paper footer. Affects only display formatting; the SNTP
            sync always uses UTC internally.
            Examples:
              Madrid (CET/CEST)        CET-1CEST,M3.5.0,M10.5.0/3
              Berlin (CET/CEST)        CET-1CEST,M3.5.0,M10.5.0/2
              New York (EST/EDT)       EST5EDT,M3.2.0,M11.1.0
              UTC                      UTC0
              Buenos Aires (UTC-3)     ART3
              Tokyo (JST)              JST-9
            Find yours at https://github.com/eggert/tz/blob/main/zone.tab

endmenu

menu "Refresh Schedule"

    config ACTIVE_HOUR_START
        int "Active hours start (0-23, inclusive)"
        range 0 23
        default 8
        help
            Beginning of the "active" window during which the ticker
            refreshes at ACTIVE_SLEEP_SEC. Outside this window it
            refreshes at QUIET_SLEEP_SEC (much longer) to save battery.

    config ACTIVE_HOUR_END
        int "Active hours end (0-23, exclusive)"
        range 0 23
        default 23
        help
            End of the "active" window (exclusive). For an 8:00-23:00
            window set start=8 and end=23.

    config ACTIVE_SLEEP_SEC
        int "Sleep duration during active hours (seconds)"
        range 60 3600
        default 300
        help
            Deep-sleep length when the local clock is within the active
            window. 300 (5 min) is a sensible default for a price ticker.

    config QUIET_SLEEP_SEC
        int "Sleep duration during quiet hours (seconds)"
        range 60 86400
        default 1800
        help
            Deep-sleep length when the local clock is outside the active
            window. 1800 (30 min) saves ~5x battery vs 5-min cadence
            during the night when nobody is looking at the ticker.

endmenu
```

## Example/ESP-IDF_5.5.1/09_E_Paper_Test/sdkconfig.defaults
```kconfig
CONFIG_IDF_TARGET="esp32s3"
CONFIG_ESPTOOLPY_FLASHMODE_QIO=y
CONFIG_ESPTOOLPY_FLASHSIZE_4MB=y
CONFIG_PARTITION_TABLE_CUSTOM=y
CONFIG_HTTPD_MAX_REQ_HDR_LEN=512
CONFIG_SPIRAM=y
CONFIG_SPIRAM_MODE_OCT=y
CONFIG_SPIRAM_SPEED_80M=y
CONFIG_FATFS_LFN_HEAP=y

# mbedTLS
CONFIG_MBEDTLS_DEBUG=y
CONFIG_MBEDTLS_DEBUG_LEVEL_VERBOSE=y
CONFIG_MBEDTLS_CERTIFICATE_BUNDLE=y
CONFIG_MBEDTLS_CERTIFICATE_BUNDLE_DEFAULT_FULL=y

# LVGL
CONFIG_LV_MEM_SIZE_KILOBYTES=64
CONFIG_LV_USE_LABEL=y
CONFIG_LV_USE_BAR=y
CONFIG_LV_USE_LINE=y
CONFIG_LV_USE_ARC=y
CONFIG_LV_USE_OBJ=y
CONFIG_LV_USE_STYLE=y
CONFIG_LV_USE_THEME_DEFAULT=y
CONFIG_LV_USE_CHART=y
CONFIG_LV_FONT_MONTSERRAT_10=y
CONFIG_LV_FONT_MONTSERRAT_12=y
CONFIG_LV_FONT_MONTSERRAT_14=y
CONFIG_LV_FONT_MONTSERRAT_16=y
CONFIG_LV_FONT_MONTSERRAT_20=y
CONFIG_LV_FONT_MONTSERRAT_24=y
CONFIG_LV_FONT_MONTSERRAT_28=y
CONFIG_LV_COLOR_DEPTH_16=y
CONFIG_LV_DRAW_BUF_STRIDE_ALIGN=y
CONFIG_LV_DRAW_BUF_ALIGN=16
CONFIG_LV_USE_ASSERT_MEM_INTEGRITY=n
CONFIG_LV_USE_PERF_MONITOR=n
CONFIG_LV_USE_MEM_MONITOR=n
CONFIG_LV_USE_SNAPSHOT=n
CONFIG_LV_USE_DRAW_SW=y
CONFIG_LV_TXT_BREAK_CHARS=" ,.;:-_)}"

# Disable IPv6 to prevent DNS/connect timeouts on IPv4-only networks
CONFIG_LWIP_IPV6=n

# Enable maximum log level compile-time support for debugging
CONFIG_LOG_MAXIMUM_LEVEL_VERBOSE=y
CONFIG_LOG_MAXIMUM_LEVEL=5
CONFIG_LOG_DEFAULT_LEVEL_INFO=y
CONFIG_LOG_DEFAULT_LEVEL=3
```
